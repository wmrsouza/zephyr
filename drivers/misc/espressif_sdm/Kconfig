## drivers/misc/espressif_sdm/Kconfig
```kconfig
# Copyright (c) 2026 Espressif Systems (Shanghai) Co., Ltd.
# SPDX-License-Identifier: Apache-2.0

config ESPRESSIF_SDM
	bool "Espressif sigma-delta modulator driver"
	default y
	depends on DT_HAS_ESPRESSIF_ESP32_SDM_ENABLED
	help
	  Enable the sigma-delta modulator driver for Espressif SoCs.

if ESPRESSIF_SDM

module = ESPRESSIF_SDM
module-str = espressif_sdm
source "subsys/logging/Kconfig.template.log_config"

endif
```
