## dts/bindings/comparator/espressif,esp32-ana-cmpr.yaml
```yaml
# Copyright (c) 2026 Espressif Systems (Shanghai) Co., Ltd.
# SPDX-License-Identifier: Apache-2.0

description: |
  Espressif Analog Comparator (ana_cmpr)

  Compares a fixed analog source GPIO pad against either an internal
  (VDD-divider) or external GPIO reference voltage, and reports the
  crossing as edge events via the generic comparator API.

  On IP v1 the source pad and, when ref-source is "external", the
  reference pad are fixed per SoC and per unit:
    ESP32-C5 unit0: source GPIO9,  external reference GPIO8
    ESP32-C61 unit0: source GPIO9, external reference GPIO8
    ESP32-H2 unit0: source GPIO11, external reference GPIO10
    ESP32-P4 unit0: source GPIO52, external reference GPIO51
    ESP32-P4 unit1: source GPIO54, external reference GPIO53

  On IP v2 (ESP32-S31) unit0 has four selectable pads:
    pad 0 GPIO37, pad 1 GPIO38, pad 2 GPIO39, pad 3 GPIO40.
  source-pad selects the measured input. ext-ref-pad selects the
  external reference when ref-source is "external". The driver assigns
  the remaining pads to the unused source channels so the one-hot mux
  fields stay unique, and scans only source channel 0. The v2 properties
  below are ignored on IP v1.

  Example (internal reference at 50% VDD):

    &ana_cmpr1 {
            status = "okay";
            ref-source = "internal";
            ref-voltage = <50>;
    };

  Example (ESP32-S31, internal reference at 50% VDD, source on GPIO37):

    &ana_cmpr0 {
            status = "okay";
            ref-source = "internal";
            ref-voltage = <50>;
            source-pad = <0>;
    };

compatible: "espressif,esp32-ana-cmpr"

include: [base.yaml]

properties:
  interrupts:
    required: true

  unit:
    type: int
    required: true
    description: |
      Analog comparator unit index (0-based). On IP v1 this selects the
      fixed source and external-reference GPIO pads; see ana_cmpr_periph.c.
      On IP v2 the pads are selected by source-pad and ext-ref-pad.

  ref-source:
    type: string
    default: "internal"
    enum:
      - "internal"
      - "external"
    description: |
      Reference voltage source. "internal" uses a VDD-divider generated by
      ref-voltage; "external" uses this unit's external-reference GPIO pad
      (fixed on IP v1, ext-ref-pad on IP v2).

  ref-voltage:
    type: int
    default: 0
    enum:
      - 0
      - 10
      - 20
      - 30
      - 40
      - 50
      - 60
      - 70
    description: |
      Internal reference voltage, in percent of VDD. Only used when
      ref-source = "internal".

  debounce-cycles:
    type: int
    default: 0
    description: |
      Debounce cycle count applied to cross detection: once a cross is
      detected, the comparator waits this many PAD_COMP_CLK cycles before
      confirming it, to filter out glitches.

  source-pad:
    type: int
    default: 0
    enum:
      - 0
      - 1
      - 2
      - 3
    description: |
      IP v2 source pad index for the measured input. On ESP32-S31, 0 is
      GPIO37, 1 is GPIO38, 2 is GPIO39 and 3 is GPIO40. Ignored on IP v1.

  ext-ref-pad:
    type: int
    default: 3
    enum:
      - 0
      - 1
      - 2
      - 3
    description: |
      IP v2 pad index of the external reference, used when ref-source is
      "external". On ESP32-S31, 3 is GPIO40. Must differ from source-pad.
      Ignored on IP v1 and when ref-source is "internal".

  hysteresis:
    type: int
    default: 0
    enum:
      - 0
      - 1
      - 2
      - 3
    description: |
      IP v2 internal-reference hysteresis level, from none (0) to the
      strongest step (3). Hardware applies it only when ref-source is
      "internal". Ignored on IP v1.

  resample-limit:
    type: int
    default: 1
    description: |
      IP v2 number of consecutive samples (1..255) required to confirm a
      level change. Ignored on IP v1.

  poll-period-cycles:
    type: int
    default: 15
    description: |
      IP v2 PAD_COMP_CLK cycles (1..65535) to wait between samples of a
      scan. Ignored on IP v1.

  scan-period-us:
    type: int
    default: 100
    description: |
      IP v2 period, in microseconds, of the timer that triggers a scan so
      edge detection stays live. 0 disables the periodic timer; get_output
      still runs one scan. Ignored on IP v1.
```
