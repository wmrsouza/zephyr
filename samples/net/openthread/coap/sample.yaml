## samples/net/openthread/coap/sample.yaml
```yaml
common:
  harness: net
  tags:
    - net
    - openthread
  depends_on: openthread
  min_flash: 140
sample:
  description: Runs the OpenThread stack as FTD with CoAP
  name: OpenThread FTD CoAP
tests:
  sample.net.openthread.ftd.coap.client:
    build_only: true
    platform_allow:
      - cc1352p7_lp
  sample.net.openthread.ftd.coap.server:
    build_only: true
    platform_allow:
      - cc1352p7_lp
    extra_configs:
      - CONFIG_OT_COAP_SAMPLE_SERVER=y
  sample.net.openthread.fdt.coap.esp32_eth_openthread_rcp_host:
    build_only: true
    extra_args:
      - EXTRA_CONF_FILE="overlay-ot-rcp-host-eth-esp32.conf"
    platform_allow:
      - esp32s3_devkitc/esp32s3/procpu
```
