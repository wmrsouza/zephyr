## Kconfig
```
config EFUSE_VIRTUAL
	bool ""

config EFUSE_VIRTUAL_KEEP_IN_FLASH
	bool ""

config SECURE_FLASH_ENCRYPTION_MODE_DEVELOPMENT
	bool ""

config IMAGE_NAME
	string "Image name"
	default "Default"

source "Kconfig.zephyr"
```

## prj.conf
```kconfig
# Ensure an MCUboot-compatible binary is generated.
CONFIG_BOOTLOADER_MCUBOOT=y

# Enable MCUmgr and dependencies.
CONFIG_NET_BUF=y
CONFIG_ZCBOR=y
CONFIG_CRC=y
CONFIG_MCUMGR=y
CONFIG_STREAM_FLASH=y
CONFIG_FLASH_MAP=y

# Enable flash operations.
CONFIG_FLASH=y

# Enable most core commands.
CONFIG_IMG_MANAGER=y
CONFIG_MCUMGR_GRP_IMG=y
CONFIG_MCUMGR_GRP_OS=y
CONFIG_MCUMGR_GRP_STAT=y
CONFIG_STATS=y

# Enable the serial MCUmgr transport.
CONFIG_MCUMGR_TRANSPORT_UART=y
CONFIG_CONSOLE=y

# Enable the shell MCUmgr transport.
CONFIG_BASE64=y
CONFIG_CRC=y
CONFIG_SHELL=y
CONFIG_SHELL_BACKEND_SERIAL=y
CONFIG_MCUMGR_TRANSPORT_SHELL=y

# mcumgr-cli application doesn't accepts log in the channel it uses
CONFIG_SHELL_LOG_BACKEND=n

CONFIG_LOG=y
CONFIG_MCUBOOT_UTIL_LOG_LEVEL_WRN=y
CONFIG_MCUMGR_LOG_LEVEL_DBG=y
CONFIG_LOG_DEFAULT_LEVEL=4

# Disable debug logging
CONFIG_LOG_MAX_LEVEL=3

CONFIG_EFUSE_VIRTUAL=y
CONFIG_EFUSE_VIRTUAL_KEEP_IN_FLASH=y
CONFIG_SECURE_FLASH_ENCRYPTION_MODE_DEVELOPMENT=y
```

## boards/esp32c3_devkitm.overlay
```dts
/ {
	chosen {
		zephyr,console = &uart0;
		zephyr,shell-uart = &uart0;
		zephyr,code-partition = &slot0_partition;
		zephyr,uart-mcumgr = &uart0;
	};
};

&uart0 {
	current-speed = <115200>;
};

&usb_serial {
	status = "disabled";
};
```

## boards/esp32s3_devkitc_procpu.overlay
```dts
/ {
	chosen {
		zephyr,console = &uart0;
		zephyr,shell-uart = &uart0;
		zephyr,code-partition = &slot0_partition;
		zephyr,uart-mcumgr = &usb_serial;
	};
};

&uart0 {
	current-speed = <115200>;
};

&usb_serial {
	status = "okay";
};
```

## src/main.c
```c
/*
 * Copyright (c) 2012-2014 Wind River Systems, Inc.
 *
 * SPDX-License-Identifier: Apache-2.0
 */

#include <stdio.h>

int main(void)
{
	printf("Hello World! %s\n\r", CONFIG_BOARD_TARGET);
	printf("Image: %s\n\r", CONFIG_IMAGE_NAME);

	return 0;
}
```
